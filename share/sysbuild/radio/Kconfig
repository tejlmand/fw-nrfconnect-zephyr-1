## share/sysbuild/radio/Kconfig
```kconfig
# Copyright (c) 2022 Nordic Semiconductor
#
# SPDX-License-Identifier: Apache-2.0

config SUPPORT_RADIO
	bool
	default y

config SUPPORT_RADIO_HCI_RPMSG
	bool
	default y

choice RADIO
	prompt "Radio support"
	default RADIO_NONE
	depends on SUPPORT_RADIO

config RADIO_NONE
	bool "None"
	help
	  Do not Include a radio image in the build

config RADIO_HCI_RPMSG
	bool "hci_rpmsg"
	depends on SUPPORT_RADIO_HCI_RPMSG
	help
	  Include hci_rpmsg as the radio image to use

endchoice
```
